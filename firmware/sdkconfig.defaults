## firmware/sdkconfig.defaults
```kconfig
; sdkconfig.defaults — для ESP32-C3 Mesh Chat
; Явно фиксируем BLE-стек: NimBLE, Bluedroid выключен (BLE_API §2).
; Это устраняет двусмысленность: если core и lib_deps тянут разные
; контроллеры, паника до setup() в lld.o (Bluedroid ROM) гарантирована.
CONFIG_BT_ENABLED=y
CONFIG_BT_BLUEDROID_ENABLED is not set
CONFIG_BT_NIMBLE_ENABLED=y
CONFIG_BT_NIMBLE_ROLE_CENTRAL=y
CONFIG_BT_NIMBLE_ROLE_PERIPHERAL=y
CONFIG_BT_NIMBLE_ROLE_BROADCASTER=y
CONFIG_BT_NIMBLE_ROLE_OBSERVER=y
CONFIG_BT_NIMBLE_MAX_CONNECTIONS=1
```
